// SPDX-License-Identifier: GPL-2.0-or-later OR MIT

/dts-v1/;

#include "ipq5018-cr880x.dtsi"

/ {
	model = "Xiaomi CR880X (M79 V1)";
	compatible = "xiaomi,cr880x-m79-v1", "qcom,ipq5018";
};

&wifi {
	qcom,ath11k-calibration-variant = "Xiaomi-CR880X-M79-V1";
};
